
#include  
#include  
#include "lcd.h" 
#include "6x8.h" 
#include "chinese.h" 

/*---------- 
LCD_init : 3310LCD初始化 

编写日期 ：2004-8-10 
最后修改日期 ：2004-8-10 
------------*/ 
void LCD_init(void) 
{ 
PORTB &= ~LCD_RST; // 产生一个让LCD复位的低电平脉冲 
delay_1us(); 
PORTB |= LCD_RST; 

PORTB &= ~LCD_CE ; // 关闭LCD 
delay_1us(); 
PORTB |= LCD_CE; // 使能LCD 
delay_1us(); 

LCD_write_byte(0x21, 0); // 使用扩展命令设置LCD模式 
LCD_write_byte(0xc8, 0); // 设置偏置电压 
LCD_write_byte(0x06, 0); // 温度校正 
LCD_write_byte(0x13, 0); // 1:48 
LCD_write_byte(0x20, 0); // 使用基本命令 
LCD_clear(); // 清屏 
LCD_write_byte(0x0c, 0); // 设定显示模式，正常显示 

PORTB &= ~LCD_CE ; // 关闭LCD 
//LCD_clear(); 
} 

/*-------- 
LCD_clear : LCD清屏函数 

编写日期 ：2004-8-10 
最后修改日期 ：2004-8-10 
-------------*/ 
void LCD_clear(void) 
{ 
unsigned int i; 

LCD_write_byte(0x0c, 0); 
LCD_write_byte(0x80, 0); 

for (i=0; i<504; i++) 
LCD_write_byte(0, 1); 
} 

/*--------- 
LCD_set_XY : 设置LCD坐标函数 

输入参数：X ：0－83 
Y ：0－5 

编写日期 ：2004-8-10 
最后修改日期 ：2004-8-10 
-----------*/ 
void LCD_set_XY(unsigned char X, unsigned char Y) 
{ 
LCD_write_byte(0x40 | Y, 0); // column 
LCD_write_byte(0x80 | X, 0); // row 
} 

/*----------- 
LCD_write_char : 显示英文字符 

输入参数：c ：显示的字符； 

编写日期 ：2004-8-10 
最后修改日期 ：2004-8-10 
-------------------*/ 
void LCD_write_char(unsigned char c) 
{ 
unsigned char line; 

//c -= 32; 

//for (line=0; line<6; line++) 
//LCD_write_byte(font6x8[c][line], 1); 
for (line=0; line<7; line++) 
LCD_write_byte(font7x13[c][line], 1); 
for (line=7; line<14; line++) 
LCD_write_byte(font7x13[c][line], 1); 

} 

/*---------- 
LCD_write_char : 英文字符串显示函数 

输入参数：*s ：英文字符串指针； 
X、Y : 显示字符串的位置 

编写日期 ：2004-8-10 
最后修改日期 ：2004-8-10 
------------*/ 
void LCD_write_String(unsigned char X,unsigned char Y,char *s) 
{ 
unsigned char line; 
unsigned char i="0"; 
while (*s) 
{ 
LCD_set_XY(X+i*7,Y); 
for (line=0; line<7; line++) 
LCD_write_byte(font7x13[*s-0X30][line], 1); 

LCD_set_XY(X+i*7,Y+1); 
for (line=7; line<14; line++) 
LCD_write_byte(font7x13[*s-0X30][line], 1); 
s++; 
i++; 
} 
} 
/*-------------------- 
LCD_write_chi: 在LCD上显示汉字 

输入参数：X、Y ：显示汉字的起始X、Y坐标； 
ch_with ：汉字点阵的宽度 
num ：显示汉字的个数； 
line ：汉字点阵数组中的起始行数 
row ：汉字显示的行间距 
编写日期 ：2004-8-11 
最后修改日期 ：2004-8-12 
---------------------------*/ 
void LCD_write_chi(unsigned char X, unsigned char Y, 
unsigned char ch_with,unsigned char num, 
unsigned char line,unsigned char row) 
{ 
unsigned char i,n; 

LCD_set_XY(X,Y); //设置初始位置 

for (i=0;i
{ 
for (n=0; n
{ 
if (n==ch_with) //写汉字的下半部分 
{ 
if (i==0) LCD_set_XY(X,Y+1); 
else 
LCD_set_XY((X+(ch_with+row)*i),Y+1); 
} 
LCD_write_byte(china_char[line+i][n],1); 
} 
i++; 
LCD_set_XY((X+(ch_with+row)*i),Y); 
} 
} 

/*-------------------------- 
LCD_write_chi: 汉字移动 

输入参数：X、Y ：显示汉字的起始X、Y坐标； 
T ：移动速度； 

编写日期 ：2004-8-13 
最后修改日期 ：2004-8-13 
-------------------------*/ 
void LCD_move_chi (unsigned char X, unsigned char Y, unsigned char T) 
{ 
unsigned char i,n,j=0; 
unsigned char buffer_h[84]={0}; 
unsigned char buffer_l[84]={0}; 

for (i=0; i<156; i++) 
{ 
buffer_h[83] = china_char[i/12][j]; 
buffer_l[83] = china_char[i/12][j+12]; 
j++; 
if (j==12) j="0"; 

for (n=0; n<83; n++) 
{ 
buffer_h[n]=buffer_h[n+1]; 
buffer_l[n]=buffer_l[n+1]; 
} 

LCD_set_XY(X,Y); 
for (n=0; n<83; n++) 
{ 
LCD_write_byte(buffer_h[n],1); 
} 

LCD_set_XY(X,Y+1); 
for (n=0; n<83; n++) 
{ 
LCD_write_byte(buffer_l[n],1); 
} 

delay_nms(T); 
} 
} 

/*------------ 
LCD_draw_map : 位图绘制函数 

输入参数：X、Y ：位图绘制的起始X、Y坐标； 
*map ：位图点阵数据； 
Pix_x ：位图像素（长） 
Pix_y ：位图像素（宽） 

编写日期 ：2004-8-13 
最后修改日期 ：2004-8-13 
--------------------*/ 
void LCD_draw_map(unsigned char X,unsigned char Y,unsigned char *map, 
unsigned char Pix_x,unsigned char Pix_y) 
{ 
unsigned int i,n; 
unsigned char row; 

if (Pix_y%8==0) row="Pix"_y/8; //计算位图所占行数 
else 
row=Pix_y/8+1; 

for (n=0;n
{ 
LCD_set_XY(X,Y); 
for(i=0; i
{ 
LCD_write_byte(map[i+n*Pix_x], 1); 
} 
Y++; //换行 
} 
} 

/*------------------------ 
LCD_write_byte : 使用SPI接口写数据到LCD 

输入参数：data ：写入的数据； 
command ：写数据/命令选择； 

编写日期 ：2004-8-10 
最后修改日期 ：2004-8-13 
--------------------------------------*/ 
void LCD_write_byte(unsigned char data, unsigned char command) 
{ 
PORTB &= ~LCD_CE ; // 使能LCD 

if (command == 0) 
PORTB &= ~LCD_DC ; // 传送命令 
else 
PORTB |= LCD_DC ; // 传送数据 

SPDR = data; // 传送数据到SPI寄存器 

while ((SPSR & 0x80) == 0); // 等待数据传送完毕 

PORTB |= LCD_CE ; // 关闭LCD 
}


位图数据表
unsigned char Bmp001[]=
{
/*------------------------------------------------------------------------------
; 源文件 / 文字 : 频率计实验
; 宽×高（像素）: 60×13
; 字模格式/大小 : 单色点阵液晶字模，纵向取模，字节倒序/120字节
; 数据转换日期 : 2004-9-23 17:39:05
------------------------------------------------------------------------------*/
0x20,0xFC,0xE0,0x3E,0xA8,0x26,0xFA,0x0A,0xEE,0x0A,0xFA,0x00,0x84,0x8C,0x54,0xA4,
0xD4,0xAE,0xD4,0xA4,0x54,0x8C,0x04,0x00,0x20,0xE2,0x04,0x00,0x20,0x20,0x20,0xFE,
0x20,0x20,0x20,0x00,0x10,0x0C,0x44,0x94,0x24,0x06,0xF4,0x04,0x04,0x14,0x0C,0x00,
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0x08,0x0B,0x08,0x0B,0x0C,0x0B,0x08,0x00
};

unsigned char MHz[]=
{
/*------------------------------------------------------------------------------
; 源文件 / 文字 : MHz
; 宽×高（像素）: 38×16
; 字模格式/大小 : 单色点阵液晶字模，纵向取模，字节倒序/76字节
; 数据转换日期 : 2004-9-27 14:27:15
------------------------------------------------------------------------------*/

//0x00,0xF8,0x30,0xC0,0x00,
//0x00,0x00,0xC0,0x30,0xF8,0x00,0x00,0xF8,0x80,0x80,0x80,0x80,0x80,0xF8,0x00,0x00,
//0x40,0x40,0x40,0xC0,0x40,0x00,

//0x00,0x1F,0x00,0x00,0x07,
//0x18,0x07,0x00,0x00,0x1F,0x00,0x00,0x1F,0x00,0x00,0x00,0x00,0x00,0x1F,0x00,0x00,
//0x10,0x1C,0x12,0x11,0x10,0x00

//0xF8,0x70,0xE0,0x10,0xC8,0x34,0xFA,
0x00,0xF8,0x30,0xC0,0x00,0xC0,0x30,0xF8,0x00,
0xF8,0x40,0x40,0x40,0x40,0xF8,0x00,0x20,0x20,0xA0,0x60,0x20,0x00,
//0x07,0x00,0x01,0x06,0x01,0x00,0x07,
0x00,0x07,0x00,0x01,0x06,0x01,0x00,0x07,0x00,
0x07,0x00,0x00,0x00,0x00,0x07,0x00,0x04,0x06,0x05,0x04,0x04,0x00

};

unsigned char Bmp002[]=
{
/*------------------------------------------------------------------------------
; 源文件 / 文字 :":"
; 宽×高（像素）: 7×14
; 字模格式/大小 : 单色点阵液晶字模，纵向取模，字节倒序/48字节
; 数据转换日期 : 2004-9-23 17:12:47
------------------------------------------------------------------------------*/
//0x00,0x00,0x06,0x06,0x00,0x00,0x00,0x00,0x00,0xC0,0xC0,0x00,0x00,0x00
0x00,0x00,0x60,0x60,0x00,0x00,0x00,0x00,0x00,0x03,0x03,0x00,0x00,0x00
};
unsigned char Bmp003[]=
/*------------------------------------------------------------------------------
; 源文件 / 文字 :"."
; 宽×高（像素）: 4×16
------------------------------------------------------------------------------*/
//{0x00,0x00,0x00,0x00,0x00,0x30,0x30,0x00};
{0x00,0x00,0x00,0x00,0x00,0x00,0x00,0x00,0x00,0x00,0x18,0x18,0x00,0x00};
//{
/*------------------------------------------------------------------------------
; 源文件 / 文字 : 没有输入信号
; 宽×高（像素）: 72×13
; 字模格式/大小 : 单色点阵液晶字模，纵向取模，字节倒序/144字节
; 数据转换日期 : 2004-9-23 17:16:17
--------------------------------------------------*/
/*
0x10,0xE2,0x74,0x10,0x68,0xDE,0x42,0x42,0xDE,0x20,0x20,0x00,0x84,0x44,0x24,0xF4,
0x9C,0x96,0x94,0x94,0xF4,0x04,0x04,0x00,0x68,0x5E,0xE8,0x48,0xD0,0x48,0xD4,0x12,
0xD4,0x08,0xD0,0x00,0x00,0x00,0x00,0x82,0x62,0x1C,0x60,0x80,0x00,0x00,0x00,0x00,
0x40,0xF0,0x0E,0x04,0x54,0x54,0x54,0x56,0x54,0x54,0x04,0x00,0x40,0x40,0x5E,0xD2,
0x52,0x52,0x52,0x52,0x5E,0x40,0x40,0x00,0x02,0x0F,0x00,0x08,0x08,0x05,0x02,0x02,
0x05,0x08,0x08,0x00,0x00,0x00,0x00,0x0F,0x02,0x02,0x02,0x0A,0x0F,0x00,0x00,0x00,
0x02,0x02,0x0F,0x01,0x0F,0x05,0x0F,0x00,0x03,0x08,0x0F,0x00,0x08,0x04,0x02,0x01,
0x00,0x00,0x00,0x01,0x02,0x04,0x08,0x00,0x00,0x0F,0x00,0x00,0x0F,0x05,0x05,0x05,
0x05,0x0F,0x00,0x00,0x00,0x00,0x00,0x01,0x01,0x09,0x09,0x09,0x07,0x00,0x00,0x00
};
*/
字符数据表


// 6 x 8 font 
// 1 pixel space at left and bottom 
// index = ASCII - 32 

const unsigned char font6x8[][6] = 
{ 
{ 0x00, 0x00, 0x00, 0x00, 0x00, 0x00 }, // sp 
{ 0x00, 0x00, 0x00, 0x2f, 0x00, 0x00 }, // ! 
{ 0x00, 0x00, 0x07, 0x00, 0x07, 0x00 }, // " 
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{ 0x14, 0x14, 0x14, 0x14, 0x14, 0x14 } // horiz lines 
}; 

// 7 x 13 font 
// 1 pixel space at left and bottom 
// index = ASCII - 32 
const unsigned char font7x13[][14] = 
{ 
/*------------------------------------------------------------------------------ 
; 源文件 / 文字 : 0123456789. 
; 宽×高（像素）: 77×13 
; 字模格式/大小 : 单色点阵液晶字模,纵向取模,字节倒序/154字节 
; 数据转换日期 : 2004-9-23 18:16:29 
------------------------------------------------------------------------------*/ 
//unsigned char code Bmp001[]= 
//{ 
/*------------------------------------------------------------------------------ 
; 源文件 / 文字 : 0123456789. 
; 宽×高（像素）: 81×14 
; 字模格式/大小 : 单色点阵液晶字模,纵向取模,字节倒序/140字节 
; 数据转换日期 : 2004-9-24 0:45:48 
------------------------------------------------------------------------------*/ 

{0xF0,0x08,0x08,0x08,0x08,0xF0,0x00,0x0F,0x10,0x10,0x10,0x10,0x0F,0x00}, 
{0x00,0x20,0x10,0xF8,0x00,0x00,0x00,0x00,0x00,0x00,0x1F,0x00,0x00,0x00}, 
{0x10,0x08,0x08,0x08,0x08,0xF0,0x00,0x10,0x18,0x14,0x12,0x11,0x10,0x00}, 
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{0xF0,0x08,0x08,0x08,0x88,0xF0,0x00,0x08,0x11,0x11,0x11,0x08,0x07,0x00} 

};


延时函数：


void delay_1us(void) //1us延时函数 
{ 
asm("nop"); 
} 

void delay_nus(unsigned int n) //N us延时函数 
{ 
unsigned int i="0"; 
for (i=0;i
delay_1us(); 
} 

void delay_1ms(void) //1ms延时函数 
{ 
unsigned int i; 
for (i=0;i<1140;i++); 
} 

void delay_nms(unsigned int n) //N ms延时函数 
{ 
unsigned int i="0"; 
for (i=0;i
delay_1ms(); 
} 
